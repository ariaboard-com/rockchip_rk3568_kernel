// SPDX-License-Identifier: (GPL-2.0+ OR MIT)
/*
 * Copyright (c) 2020 Rockchip Electronics Co., Ltd.
 *
 */

/dts-v1/;

#include "rk3568-firefly-aioj.dtsi"

/*
*								select camera
*
* using single camera xc7160        --->  rk3568-firefly-aioj-cam-8ms1m.dtsi
* using dual camera gc2053/gc2093   --->  rk3568-firefly-aioj-cam-2ms2m.dtsi
*
*/
#include "rk3568-firefly-aioj-cam-8ms1m.dtsi"

/ {
    model = "AIO-3568J HDMI (Linux)";
    compatible = "rockchip,rk3568-firefly-aioj", "rockchip,rk3568";

};

&route_hdmi {
    status = "okay";
    connect = <&vp0_out_hdmi>;
};
