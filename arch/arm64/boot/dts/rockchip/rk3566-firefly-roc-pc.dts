// SPDX-License-Identifier: (GPL-2.0+ OR MIT)
/*
 * Copyright (c) 2020 Rockchip Electronics Co., Ltd.
 *
 */

 /dts-v1/;

#include "rk3566-firefly-roc-pc.dtsi"

/ {
    model = "Firefly RK3566-ROC-PC HDMI(Linux)";
    compatible = "rockchip,rk3566-firefly-roc-pc", "rockchip,rk3566";
};
