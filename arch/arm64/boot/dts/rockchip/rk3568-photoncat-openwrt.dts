// SPDX-License-Identifier: (GPL-2.0+ OR MIT)
/*
 * Copyright (c) 2020 Rockchip Electronics Co., Ltd.
 *
 */

/dts-v1/;

#include "rk3568-photoncat.dtsi"
#include "rk3568-linux.dtsi"

/ {
	model = "Rockchip RK3568 PhotonCat Linux Board";
	compatible = "rockchip,rk3568-photoncat", "rockchip,rk3568";
	
	chosen: chosen {
		bootargs = "earlycon=uart8250,mmio32,0xfe660000 console=ttyFIQ0 root=/dev/mmcblk0p6 rootfstype=squashfs rootwait coherent_pool=1m systemd.gpt_auto=0 cgroup_enable=memory swapaccount=1";
	};
};
