// SPDX-License-Identifier: (GPL-2.0+ OR MIT)
/*
 * Copyright (c) 2020 Rockchip Electronics Co., Ltd.
 *
 */

/dts-v1/;

#include "rk3568-photonicat.dtsi"
#include "rk3568-linux.dtsi"

/ {
	model = "Rockchip RK3568 PhotoniCat Linux Board";
	compatible = "rockchip,rk3568-photonicat", "rockchip,rk3568";
/*	
	reserved-memory {
		#address-cells = <2>;
		#size-cells = <2>;
		ranges;

		rknpu_reserved: rknpu {
			compatible = "shared-dma-pool";
			inactive;
			reusable;
			size = <0x0 0x20000000>;
			alignment = <0x0 0x1000>;
		};
	};
*/
};

&rknpu {
	memory-region = <&rknpu_reserved>;
	rknpu-supply = <&vdd_npu>;

	status = "disabled";
};

&rknpu_mmu {
	status = "disabled";
};

