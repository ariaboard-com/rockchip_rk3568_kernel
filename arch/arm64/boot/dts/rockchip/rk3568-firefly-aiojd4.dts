// SPDX-License-Identifier: (GPL-2.0+ OR MIT)
/*
 * Copyright (c) 2020 Rockchip Electronics Co., Ltd.
 *
 */

/dts-v1/;

#include "rk3568-firefly-aiojd4.dtsi"

/ {
    model = "AIO-3568JD4 HDMI (Linux)";
    compatible = "rockchip,rk3568-firefly-aiojd4", "rockchip,rk3568";

};

&route_hdmi {
    status = "okay";
    connect = <&vp0_out_hdmi>;
};
