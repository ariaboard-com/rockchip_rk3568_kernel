// SPDX-License-Identifier: (GPL-2.0+ OR MIT)
/*
 * Copyright (c) 2020 Rockchip Electronics Co., Ltd.
 *
 */

 /dts-v1/;

#include "rk3566-firefly-aiojd4.dtsi"

/*
*								select camera
*
* using single camera xc7160        --->  rk3566-firefly-aiojd4-cam-8ms1m.dtsi
* using dual camera gc2053/gc2093   --->  rk3566-firefly-aiojd4-cam-2ms2m.dtsi
*
*/
#include "rk3566-firefly-aiojd4-cam-8ms1m.dtsi"

/ {
    model = "AIO-3566JD4 HDMI(Linux)";
    compatible = "rockchip,rk3566-firefly-aiojd4", "rockchip,rk3566";
};
