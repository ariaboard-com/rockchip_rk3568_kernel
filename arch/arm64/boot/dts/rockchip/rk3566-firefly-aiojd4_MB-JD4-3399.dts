// SPDX-License-Identifier: (GPL-2.0+ OR MIT)
/*
 * Copyright (c) 2020 Rockchip Electronics Co., Ltd.
 *
 */

 /dts-v1/;

#include "rk3566-firefly-aiojd4_MB-JD4-3399.dtsi"

/ {
    model = "AIO-3566JD4_MB-JD4-3399 HDMI(Linux)";
    compatible = "rockchip,rk3566-firefly-aiojd4", "rockchip,rk3566";
};
