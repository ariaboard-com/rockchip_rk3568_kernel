// SPDX-License-Identifier: (GPL-2.0+ OR MIT)
/*
 * Copyright (c) 2020 Rockchip Electronics Co., Ltd.
 *
 */

/dts-v1/;

#include "rk3568-gw-v10.dtsi"
#include "rk3568-linux.dtsi"

/ {
	model = "Rockchip RK3568 GW V10 Linux Board";
	compatible = "rockchip,rk3568-gw-v10", "rockchip,rk3568";
};
