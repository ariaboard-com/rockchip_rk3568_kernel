## net/fast-classifier/Kconfig
```kconfig
config FAST_CLASSIFIER
	tristate "Fast classifier"
	depends on SHORTCUT_FE
	---help---
	  Shortcut is a fast in-kernel packet forwarding engine.

	  To compile this code as a module, choose M here: the module will be
	  called fast-classifier.

	  If unsure, say N.
```

## net/shortcut-fe/Kconfig
```kconfig
#
# Shortcut forwarding engine
#

config SHORTCUT_FE
	tristate "Shortcut Forwarding Engine"
	depends on NF_CONNTRACK
	---help---
	  Shortcut is a fast in-kernel packet forwarding engine.

	  To compile this code as a module, choose M here: the module will be
	  called shortcut-fe.

	  If unsure, say N.

config SFE_SUPPORT_IPV6
	bool "IPv6 support for SFE"
	depends on SHORTCUT_FE

config SHORTCUT_FE_CM
	tristate "Shortcut Forwarding Engine Connection Manager"
	depends on SHORTCUT_FE
	---help---
	  Connection Manager for Shortcut Forwarding Engine.

	  To compile this code as a module, choose M here: the module will be
	  called shortcut-fe-cm.

	  If unsure, say N.
```
